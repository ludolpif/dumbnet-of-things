/*
 *  Copyright (c) 2025 ludolpif <ludolpif@gmail.com>
 *  This file is part of 1keyboard_2computers.
 *
 *  1keyboard_2computers is free software: you can redistribute it and/or modify it under the terms of
 *  the GNU General Public License as published by the Free Software Foundation,
 *  either version 3 of the License, or (at your option) any later version.
 *
 *  1keyboard_2computers is distributed in the hope that it will be useful, but WITHOUT ANY
 *  WARRANTY; without even the implied warranty of MERCHANTABILITY or
 *  FITNESS FOR A PARTICULAR PURPOSE. See the GNU General Public License for
 *  more details.
 *
 *  You should have received a copy of the GNU General Public License along with
 *  1keyboard_2computers. If not, see <https://www.gnu.org/licenses/>
 */
#include "config.h"
#include <HID-Project.h>
#include <PS2KeyAdvanced.h> /* for constants only */

#ifdef SERIAL_DEBUG
void usbkey_trace( enum KeyboardKeycode usbkeycode) {
  Serial.print("USB_KEY 0x" );
  if ( usbkeycode < 0x10 ) Serial.print("0");
  Serial.println( usbkeycode, HEX );
}
#endif /* SERIAL_DEBUG */

uint8_t usb_query_leds() {
  uint8_t ps2_leds = 0;
  enum KeyboardLeds usb_leds = BootKeyboard.getLeds();
  /* HID-Project LED bits :
    LED_NUM_LOCK        = (1 << 0),
    LED_CAPS_LOCK       = (1 << 1),
    LED_SCROLL_LOCK     = (1 << 2),
    LED_COMPOSE         = (1 << 3),
    LED_KANA            = (1 << 4),
    LED_POWER           = (1 << 5),
    LED_SHIFT           = (1 << 6),
    LED_DO_NOT_DISTURB  = (1 << 7),

    PS2 Protocol LED bits :
    #define PS2_LOCK_SCROLL  0x01
    #define PS2_LOCK_NUM     0x02
    #define PS2_LOCK_CAPS    0x04
    #define PS2_LOCK_EXTRA   0x08
*/
  if ( usb_leds & LED_NUM_LOCK ) ps2_leds |= PS2_LOCK_NUM;
  if ( usb_leds & LED_CAPS_LOCK ) ps2_leds |= PS2_LOCK_CAPS;
  if ( usb_leds & LED_SCROLL_LOCK ) ps2_leds |= PS2_LOCK_SCROLL;
  if ( usb_leds & LED_COMPOSE ) ps2_leds |= PS2_LOCK_EXTRA;

  return ps2_leds;
}

int usb_release_all() {
  BootKeyboard.removeAll();
  return BootKeyboard.send();
}

#if defined(PS2_REQUIRES_PROGMEM)
const enum KeyboardKeycode PROGMEM PS2ToUSBKeyMap[] {
#else
const enum KeyboardKeycode PS2ToUSBKeyMap[] {
#endif
/*0x00 (none) */ KEY_RESERVED,
/*0x01 PS2_KEY_NUM */ KEY_NUM_LOCK,
/*0x02 PS2_KEY_SCROLL */ KEY_SCROLL_LOCK,
/*0x03 PS2_KEY_CAPS */ KEY_CAPS_LOCK,
/*0x04 PS2_KEY_PRTSCR */ KEY_PRINT,
/*0x05 PS2_KEY_PAUSE */ KEY_PAUSE,
/*0x06 PS2_KEY_L_SHIFT */ KEY_LEFT_SHIFT,
/*0x07 PS2_KEY_R_SHIFT */ KEY_RIGHT_SHIFT,
/*0x08 PS2_KEY_L_CTRL */ KEY_LEFT_CTRL,
/*0x09 PS2_KEY_R_CTRL */ KEY_RIGHT_CTRL,
/*0x0A PS2_KEY_L_ALT */ KEY_LEFT_ALT,
/*0x0B PS2_KEY_R_ALT */ KEY_RIGHT_ALT,
/*0x0C PS2_KEY_L_GUI */ KEY_LEFT_GUI,
/*0x0D PS2_KEY_R_GUI */ KEY_RIGHT_GUI,
/*0x0E PS2_KEY_MENU */ KEY_APPLICATION,
/* Break is CTRL + PAUSE generated inside keyboard */
/*0x0F PS2_KEY_BREAK */ KEY_RESERVED,
/* Generated by some keyboards by ALT and PRTSCR */
/*0x10 PS2_KEY_SYSRQ */ KEY_RESERVED,
/*0x11 PS2_KEY_HOME */ KEY_HOME,
/*0x12 PS2_KEY_END */ KEY_END,
/*0x13 PS2_KEY_PGUP */ KEY_PAGE_UP,
/*0x14 PS2_KEY_PGDN */ KEY_PAGE_DOWN,
/*0x15 PS2_KEY_L_ARROW */ KEY_LEFT_ARROW,
/*0x16 PS2_KEY_R_ARROW */ KEY_RIGHT_ARROW,
/*0x17 PS2_KEY_UP_ARROW */ KEY_UP_ARROW,
/*0x18 PS2_KEY_DN_ARROW */ KEY_DOWN_ARROW,
/*0x19 PS2_KEY_INSERT */ KEY_INSERT,
/*0x1A PS2_KEY_DELETE */ KEY_DELETE,
/*0x1B PS2_KEY_ESC */ KEY_ESC,
/*0x1C PS2_KEY_BS */ KEY_BACKSPACE,
/*0x1D PS2_KEY_TAB */ KEY_TAB,
/*0x1E PS2_KEY_ENTER */ KEY_ENTER,
/*0x1F PS2_KEY_SPACE */ KEY_SPACE,
/*0x20 PS2_KEY_KP0 */ KEYPAD_0,
/*0x21 PS2_KEY_KP1 */ KEYPAD_1,
/*0x22 PS2_KEY_KP2 */ KEYPAD_2,
/*0x23 PS2_KEY_KP3 */ KEYPAD_3,
/*0x24 PS2_KEY_KP4 */ KEYPAD_4,
/*0x25 PS2_KEY_KP5 */ KEYPAD_5,
/*0x26 PS2_KEY_KP6 */ KEYPAD_6,
/*0x27 PS2_KEY_KP7 */ KEYPAD_7,
/*0x28 PS2_KEY_KP8 */ KEYPAD_8,
/*0x29 PS2_KEY_KP9 */ KEYPAD_9,
/*0x2A PS2_KEY_KP_DOT */ KEYPAD_DOT,
/*0x2B PS2_KEY_KP_ENTER */ KEYPAD_ENTER,
/*0x2C PS2_KEY_KP_PLUS */ KEYPAD_ADD,
/*0x2D PS2_KEY_KP_MINUS */ KEYPAD_SUBTRACT,
/*0x2E PS2_KEY_KP_TIMES */ KEYPAD_MULTIPLY,
/*0x2F PS2_KEY_KP_DIV */ KEYPAD_DIVIDE,
/*0x30 PS2_KEY_0 */ KEY_0,
/*0x31 PS2_KEY_1 */ KEY_1,
/*0x32 PS2_KEY_2 */ KEY_2,
/*0x33 PS2_KEY_3 */ KEY_3,
/*0x34 PS2_KEY_4 */ KEY_4,
/*0x35 PS2_KEY_5 */ KEY_5,
/*0x36 PS2_KEY_6 */ KEY_6,
/*0x37 PS2_KEY_7 */ KEY_7,
/*0x38 PS2_KEY_8 */ KEY_8,
/*0x39 PS2_KEY_9 */ KEY_9,
/*0x3A PS2_KEY_APOS */ KEY_QUOTE,
/*0x3B PS2_KEY_COMMA */ KEY_COMMA,
/*0x3C PS2_KEY_MINUS */ KEY_MINUS,
/*0x3D PS2_KEY_DOT */ KEY_PERIOD,
/*0x3E PS2_KEY_DIV */ KEY_SLASH,
/* Some Numeric keyboards have an '=' on right keypad, USB: Dont confuse with KEYPAD_EQUAL_SIGN */
/*0x3F PS2_KEY_KP_EQUAL */ KEY_PAD_EQUALS,
/* Is ² key un French layout, or ` and ~ key on US layout */
/*0x40 PS2_KEY_SINGLE */ KEY_TILDE,
/*0x41 PS2_KEY_A */ KEY_A,
/*0x42 PS2_KEY_B */ KEY_B,
/*0x43 PS2_KEY_C */ KEY_C,
/*0x44 PS2_KEY_D */ KEY_D,
/*0x45 PS2_KEY_E */ KEY_E,
/*0x46 PS2_KEY_F */ KEY_F,
/*0x47 PS2_KEY_G */ KEY_G,
/*0x48 PS2_KEY_H */ KEY_H,
/*0x49 PS2_KEY_I */ KEY_I,
/*0x4A PS2_KEY_J */ KEY_J,
/*0x4B PS2_KEY_K */ KEY_K,
/*0x4C PS2_KEY_L */ KEY_L,
/*0x4D PS2_KEY_M */ KEY_M,
/*0x4E PS2_KEY_N */ KEY_N,
/*0x4F PS2_KEY_O */ KEY_O,
/*0x50 PS2_KEY_P */ KEY_P,
/*0x51 PS2_KEY_Q */ KEY_Q,
/*0x52 PS2_KEY_R */ KEY_R,
/*0x53 PS2_KEY_S */ KEY_S,
/*0x54 PS2_KEY_T */ KEY_T,
/*0x55 PS2_KEY_U */ KEY_U,
/*0x56 PS2_KEY_V */ KEY_V,
/*0x57 PS2_KEY_W */ KEY_W,
/*0x58 PS2_KEY_X */ KEY_X,
/*0x59 PS2_KEY_Y */ KEY_Y,
/*0x5A PS2_KEY_Z */ KEY_Z,
/*0x5B PS2_KEY_SEMI */ KEY_SEMICOLON,
/*0x5C PS2_KEY_BACK */ KEY_BACKSLASH,
/*0x5D PS2_KEY_OPEN_SQ */ KEY_LEFT_BRACE,
/*0x5E PS2_KEY_CLOSE_SQ */ KEY_RIGHT_BRACE,
/*0x5F PS2_KEY_EQUAL */ KEY_EQUAL,
/* Some Numeric keypads have a comma key */
/*0x60 PS2_KEY_KP_COMMA */ KEYPAD_COMMA,
/*0x61 PS2_KEY_F1 */ KEY_F1,
/*0x62 PS2_KEY_F2 */ KEY_F2,
/*0x63 PS2_KEY_F3 */ KEY_F3,
/*0x64 PS2_KEY_F4 */ KEY_F4,
/*0x65 PS2_KEY_F5 */ KEY_F5,
/*0x66 PS2_KEY_F6 */ KEY_F6,
/*0x67 PS2_KEY_F7 */ KEY_F7,
/*0x68 PS2_KEY_F8 */ KEY_F8,
/*0x69 PS2_KEY_F9 */ KEY_F9,
/*0x6A PS2_KEY_F10 */ KEY_F10,
/*0x6B PS2_KEY_F11 */ KEY_F11,
/*0x6C PS2_KEY_F12 */ KEY_F12,
/*0x6D PS2_KEY_F13 */ KEY_F13,
/*0x6E PS2_KEY_F14 */ KEY_F14,
/*0x6F PS2_KEY_F15 */ KEY_F15,
/*0x70 PS2_KEY_F16 */ KEY_F16,
/*0x71 PS2_KEY_F17 */ KEY_F17,
/*0x72 PS2_KEY_F18 */ KEY_F18,
/*0x73 PS2_KEY_F19 */ KEY_F19,
/*0x74 PS2_KEY_F20 */ KEY_F20,
/*0x75 PS2_KEY_F21 */ KEY_F21,
/*0x76 PS2_KEY_F22 */ KEY_F22,
/*0x77 PS2_KEY_F23 */ KEY_F23,
/*0x78 PS2_KEY_F24 */ KEY_F24,
/*0x79 PS2_KEY_NEXT_TR */ KEY_RESERVED,
/*0x7A PS2_KEY_PREV_TR */ KEY_RESERVED,
/*0x7B PS2_KEY_STOP */ KEY_RESERVED,
/*0x7C PS2_KEY_PLAY */ KEY_RESERVED,
/*0x7D PS2_KEY_MUTE */ KEY_MUTE,
/*0x7E PS2_KEY_VOL_UP */ KEY_VOLUME_UP,
/*0x7F PS2_KEY_VOL_DN */ KEY_VOLUME_DOWN,
/*0x80 PS2_KEY_MEDIA */ KEY_RESERVED,
/*0x81 PS2_KEY_EMAIL */ KEY_RESERVED,
/*0x82 PS2_KEY_CALC */ KEY_RESERVED,
/*0x83 PS2_KEY_COMPUTER */ KEY_RESERVED,
/*0x84 PS2_KEY_WEB_SEARCH */ KEY_RESERVED,
/*0x85 PS2_KEY_WEB_HOME */ KEY_RESERVED,
/*0x86 PS2_KEY_WEB_BACK */ KEY_RESERVED,
/*0x87 PS2_KEY_WEB_FORWARD */ KEY_RESERVED,
/*0x88 PS2_KEY_WEB_STOP */ KEY_RESERVED,
/*0x89 PS2_KEY_WEB_REFRESH */ KEY_RESERVED,
/*0x8A PS2_KEY_WEB_FAVOR */ KEY_RESERVED,
/*0x8B PS2_KEY_EUROPE2 */ KEY_NON_US,
/*0x8C PS2_KEY_POWER */ KEY_POWER,
/*0x8D PS2_KEY_SLEEP */ KEY_RESERVED,
/*0x90 PS2_KEY_WAKE */ KEY_RESERVED,
/*0x91 PS2_KEY_INTL1 */ KEY_INTERNATIONAL1,
/*0x92 PS2_KEY_INTL2 */ KEY_INTERNATIONAL2,
/*0x93 PS2_KEY_INTL3 */ KEY_INTERNATIONAL3,
/*0x94 PS2_KEY_INTL4 */ KEY_INTERNATIONAL4,
/*0x95 PS2_KEY_INTL5 */ KEY_INTERNATIONAL5,
/*0x96 PS2_KEY_LANG1 */ KEY_LANG1,
/*0x97 PS2_KEY_LANG2 */ KEY_LANG2,
/*0x98 PS2_KEY_LANG3 */ KEY_LANG3,
/*0x99 PS2_KEY_LANG4 */ KEY_LANG4,
/*0x9A PS2_KEY_LANG5 */ KEY_LANG5
};

enum KeyboardKeycode map_ps2_to_usb_key(uint16_t PS2KeyAdvancedKeyCode) {
  enum KeyboardKeycode result = KEY_RESERVED;
  uint8_t idx = (uint8_t) (PS2KeyAdvancedKeyCode & 0xFF);
  uint8_t data;

  if ( idx >= sizeof(PS2ToUSBKeyMap)/sizeof(PS2ToUSBKeyMap[0]) ) {
    return KEY_RESERVED;
  }

#if defined( PS2_REQUIRES_PROGMEM )
  data = pgm_read_byte(&PS2ToUSBKeyMap[idx]);
#else
  data = PS2ToUSBKeyMap[idx];
#endif

  return KeyboardKeycode(data);
}
